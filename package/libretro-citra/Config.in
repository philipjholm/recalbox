## package/libretro-citra/Config.in
```kconfig
config BR2_PACKAGE_LIBRETRO_CITRA
	bool "libretro-citra"
	depends on BR2_PACKAGE_RETROARCH
	depends on BR2_INSTALL_LIBSTDCPP
	select BR2_PACKAGE_SDL2
	select BR2_PACKAGE_FMT
	select BR2_PACKAGE_BOOST
	select BR2_PACKAGE_RECALBOX_ROMFS_3DS
	help
	  A libretro Nintendo 3DS emulator core.

	  http://www.libretro.com

comment "LIBRETRO_CITRA needs a toolchain w/ C++"
	depends on !BR2_INSTALL_LIBSTDCPP
```

## package/python-uinput/Config.in
```kconfig
config BR2_PACKAGE_PYTHON_UINPUT
	bool "python-uinput"
	depends on BR2_PACKAGE_PYTHON
	help
	  Pythonic API to Linux uinput module
```
